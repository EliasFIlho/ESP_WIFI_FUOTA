## main/Kconfig.projbuild
```kconfig
menu "Wifi Connection"

    config ESP_WIFI_SSID
        string "WiFi SSID"
        default "myssid"
        help
            SSID (network name) for the example to connect to.

    config ESP_WIFI_PASSWORD
        string "WiFi Password"
        default "mypassword"
        help
            WiFi password (WPA or WPA2) for the example to use.

    config ESP_MAXIMUM_RETRY
        int "Maximum retry"
        default 5
        help
            Set the Maximum retry to avoid station reconnecting to the AP unlimited when the AP is really inexistent.
endmenu


menu "NETWORK INTERFACE"

    choice ESP_NETWORK_INTERFACE
        prompt "Interface de rede do firmware"
            default ESP_WIFI_INTERFACE
                config ESP_WIFI_INTERFACE
                    bool "WIFI"
                config ESP_ETH_INTERFACE
                    bool "ETHERT"
                config ESP_WIFI_ETH_INTERFACE
                    bool "ETHERT AND WIFI"
        help 
            Define qual interface de rede utilizar
    endchoice
endmenu
```
